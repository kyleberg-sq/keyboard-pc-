/ {
    chosen {
        zmk,kscan = &kscan0;
        zmk,matrix-transform = &default_transform;
    };
    default_transform: keymap_transform_0 {
        compatible = "zmk,matrix-transform";
        columns = <5>;
        rows = <4>;
        map = <
            0x0000 0x0001 0x0002 0x0003 0x0004
            0x0100 0x0101 0x0102 0x0103 0x0104
            0x0200 0x0201 0x0202 0x0203 0x0204
            0x0300 0x0301 0x0302
        >;
    };
    kscan0: kscan_0 {
        compatible = "zmk,kscan-gpio-matrix";
        diode-direction = "col2row";
        row-gpios
            = <&pro_micro 7 (GPIO_ACTIVE_HIGH | GPIO_PULL_DOWN)>  // D7
            , <&pro_micro 6 (GPIO_ACTIVE_HIGH | GPIO_PULL_DOWN)>  // D6
            , <&pro_micro 5 (GPIO_ACTIVE_HIGH | GPIO_PULL_DOWN)>  // D5
            , <&pro_micro 4 (GPIO_ACTIVE_HIGH | GPIO_PULL_DOWN)>  // D4
            ;
        col-gpios
            = <&pro_micro 14 GPIO_ACTIVE_HIGH>  // D14
            , <&pro_micro 15 GPIO_ACTIVE_HIGH>  // D15
            , <&pro_micro 18 GPIO_ACTIVE_HIGH>  // D18
            , <&pro_micro 19 GPIO_ACTIVE_HIGH>  // D19
            , <&pro_micro 20 GPIO_ACTIVE_HIGH>  // D20
            ;
    };
};