## boards/shields/custom_split/Kconfig.defconfig
```kconfig
if SHIELD_CUSTOM_SPLIT_LEFT

config ZMK_KEYBOARD_NAME
    default "Custom Split"

config ZMK_SPLIT_ROLE_CENTRAL
    default y

endif # SHIELD_CUSTOM_SPLIT_LEFT

if SHIELD_CUSTOM_SPLIT_RIGHT

config ZMK_KEYBOARD_NAME
    default "Custom Split"

endif # SHIELD_CUSTOM_SPLIT_RIGHT
```
