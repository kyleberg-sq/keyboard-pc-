## config/boards/shields/custom_split/Kconfig.defconfig
```kconfig
if SHIELD_CUSTOM_SPLIT_LEFT

config ZMK_KEYBOARD_NAME
    default "Custom Split"

config ZMK_SPLIT
    default y

endif

if SHIELD_CUSTOM_SPLIT_RIGHT

config ZMK_KEYBOARD_NAME
    default "Custom Split"

config ZMK_SPLIT
    default y

config ZMK_SPLIT_ROLE_CENTRAL
    default n

endif
```
